#include <stdint.h>
#include <string.h>

#include "freertos/FreeRTOS.h"
#include "freertos/task.h"
#include "freertos/event_groups.h"

#include "esp_err.h"
#include "esp_log.h"
#include "esp_event.h"
#include "esp_system.h"
#include "esp_partition.h"
#include "nvs_flash.h"

#include "driver/gpio.h"
#include "driver/rmt_tx.h"
#include "driver/usb_serial_jtag.h"

#include "led_strip_encoder.h"

// WIFI
#include "esp_wifi.h"
#include "esp_tls_crypto.h"
#include "esp_http_server.h"

#include "lwip/err.h"
#include "lwip/sys.h"

#include "sdkconfig.h"

#include "pages.h"
#include "link.h"
#include "swio_programmer.h"
#include "expander_image.h" // const unsigned char expander_bin[]; expander_bin_length

#define RMT_LED_STRIP_RESOLUTION_HZ 10000000 // 10MHz, 1 tick = 0.1us
#define RMT_LED_STRIP_GPIO_NUM      8
#define NUM_LEDS 11

// v4: 3 point-to-point links to the CH32V003 expanders (was I2C SDA/SCL),
// gpio0/1/2 — see link.c. Same gpio is SWIO in program mode, UART TX in operation.
#define FRAME_SYNC 0xAA

// GPIO3: external VCC switch control (0 = 5V normal operation, 1 = 3.3V programming mode)
#define VCC_SWITCH_GPIO 3

static const char *TAG = "XAPOH";

// Embedded CH32V003 image (sw-v4/main.bin) — compiled in via expander_image.h
// (generated by sw-panel-v4/bin-to-h.js). Flashed on explicit command only.

static EventGroupHandle_t s_wifi_event_group;
#define WIFI_CONNECTED_BIT BIT0
#define WIFI_FAIL_BIT      BIT1

struct app_context_s {
  uint8_t pixels[NUM_LEDS * 3];
  const void *config_ptr;
};
typedef struct app_context_s app_context_t;

static app_context_t cntxt0;
static rmt_channel_handle_t led_chan = NULL;
static rmt_encoder_handle_t led_encoder0 = NULL;
static rmt_transmit_config_t tx_config = { .loop_count = 0 };
static int s_retry_num = 0;

// --- expander link ----------------------------------------------------------
// Send the full-state frame (0xAA b0 b1 b2 csum) to expander `idx` (0..2).
static void send_expander(int idx, uint8_t b0, uint8_t b1, uint8_t b2) {
  if (idx < 0 || idx > 2) return;
  uint8_t frame[5] = {FRAME_SYNC, b0, b1, b2, (uint8_t)(b0 ^ b1 ^ b2)};
  link_send(idx, frame, sizeof(frame));
}

// --- WiFi -------------------------------------------------------------------
static void event_handler(void* arg, esp_event_base_t event_base, int32_t event_id, void* event_data) {
  if (event_base == WIFI_EVENT && event_id == WIFI_EVENT_STA_START) {
    esp_wifi_connect();
  } else if (event_base == WIFI_EVENT && event_id == WIFI_EVENT_STA_DISCONNECTED) {
    if (s_retry_num < 100) {
      esp_wifi_connect();
      s_retry_num++;
      ESP_LOGI(TAG, "retry to connect to the AP");
    } else {
      xEventGroupSetBits(s_wifi_event_group, WIFI_FAIL_BIT);
    }
  } else if (event_base == IP_EVENT && event_id == IP_EVENT_STA_GOT_IP) {
    ip_event_got_ip_t* event = (ip_event_got_ip_t*) event_data;
    ESP_LOGI(TAG, "got ip:" IPSTR, IP2STR(&event->ip_info.ip));
    s_retry_num = 0;
    xEventGroupSetBits(s_wifi_event_group, WIFI_CONNECTED_BIT);
  }
}

void wifi_init_sta(app_context_t *cntxt) {
  s_wifi_event_group = xEventGroupCreate();
  ESP_ERROR_CHECK(esp_netif_init());
  ESP_ERROR_CHECK(esp_event_loop_create_default());
  esp_netif_create_default_wifi_sta();

  wifi_init_config_t cfg = WIFI_INIT_CONFIG_DEFAULT();
  ESP_ERROR_CHECK(esp_wifi_init(&cfg));

  esp_event_handler_instance_t instance_any_id, instance_got_ip;
  ESP_ERROR_CHECK(esp_event_handler_instance_register(WIFI_EVENT, ESP_EVENT_ANY_ID, &event_handler, NULL, &instance_any_id));
  ESP_ERROR_CHECK(esp_event_handler_instance_register(IP_EVENT, IP_EVENT_STA_GOT_IP, &event_handler, NULL, &instance_got_ip));

  wifi_config_t wifi_config = {0};
  memcpy(&wifi_config.sta.ssid, (char *)cntxt->config_ptr, sizeof(wifi_config.sta.ssid));
  memcpy(&wifi_config.sta.password, ((char *)cntxt->config_ptr) + 32, sizeof(wifi_config.sta.password));

  ESP_ERROR_CHECK(esp_wifi_set_mode(WIFI_MODE_STA));
  ESP_ERROR_CHECK(esp_wifi_set_config(WIFI_IF_STA, &wifi_config));
  ESP_ERROR_CHECK(esp_wifi_start());
  ESP_LOGI(TAG, "wifi_init_sta finished.");

  EventBits_t bits = xEventGroupWaitBits(
    s_wifi_event_group, WIFI_CONNECTED_BIT | WIFI_FAIL_BIT, pdFALSE, pdFALSE, portMAX_DELAY);
  if (bits & WIFI_CONNECTED_BIT) {
    ESP_LOGI(TAG, "connected to ap");
  } else {
    ESP_LOGE(TAG, "wifi connect failed");
  }
}

// --- HTTP / WS --------------------------------------------------------------
esp_err_t index_get_handler(httpd_req_t *req) {
  httpd_resp_send(req, PAGE_index, PAGE_index_length);
  return ESP_OK;
}

// WS message protocol (operation mode, over WiFi):
//   [255, ...30 led bytes]      -> RGB strip
//   [target(0..2), b0, b1, b2]  -> push expander full-state
esp_err_t msg_handler(httpd_req_t *req) {
  if (req->method == HTTP_GET) return ESP_OK; // handshake

  httpd_ws_frame_t ws_pkt;
  memset(&ws_pkt, 0, sizeof(ws_pkt));
  ws_pkt.type = HTTPD_WS_TYPE_BINARY;
  esp_err_t ret = httpd_ws_recv_frame(req, &ws_pkt, 0);
  if (ret != ESP_OK) return ret;

  if (ws_pkt.len) {
    uint8_t *buf = calloc(ws_pkt.len, 1);
    if (!buf) return ESP_ERR_NO_MEM;
    ws_pkt.payload = buf;
    ret = httpd_ws_recv_frame(req, &ws_pkt, ws_pkt.len);
    if (ret != ESP_OK) { free(buf); return ret; }

    if (buf[0] == 255) { // RGB
      size_t n = ws_pkt.len - 1;
      if (n > sizeof(cntxt0.pixels)) n = sizeof(cntxt0.pixels);
      memcpy(cntxt0.pixels, buf + 1, n);
      ESP_ERROR_CHECK(rmt_transmit(led_chan, led_encoder0, cntxt0.pixels, sizeof(cntxt0.pixels), &tx_config));
      ESP_ERROR_CHECK(rmt_tx_wait_all_done(led_chan, portMAX_DELAY));
    } else if (ws_pkt.len >= 4 && buf[0] < 3) { // expander state
      send_expander(buf[0], buf[1], buf[2], buf[3]);
    }
    free(buf);
  }

  ws_pkt.payload = NULL;
  ws_pkt.len = 0;
  return httpd_ws_send_frame(req, &ws_pkt);
}

httpd_uri_t uri_get = { .uri = "/", .method = HTTP_GET, .handler = index_get_handler, .user_ctx = NULL };
httpd_uri_t msg_get = { .uri = "/dev1", .method = HTTP_GET, .handler = msg_handler, .user_ctx = NULL, .is_websocket = true };
httpd_uri_t msg_post = { .uri = "/dev1", .method = HTTP_POST, .handler = msg_handler, .user_ctx = NULL, .is_websocket = true };

httpd_handle_t start_webserver(void) {
  httpd_config_t config = HTTPD_DEFAULT_CONFIG();
  config.stack_size = 16384;
  httpd_handle_t server = NULL;
  if (httpd_start(&server, &config) == ESP_OK) {
    httpd_register_uri_handler(server, &uri_get);
    httpd_register_uri_handler(server, &msg_get);
    httpd_register_uri_handler(server, &msg_post);
  }
  return server;
}

void config_map_init(app_context_t *cntxt) {
  const esp_partition_t *config_partition = esp_partition_find_first(
    ESP_PARTITION_TYPE_DATA, ESP_PARTITION_SUBTYPE_ANY, "config");
  assert(config_partition != NULL);
  esp_partition_mmap_handle_t h;
  ESP_ERROR_CHECK(esp_partition_mmap(config_partition, 0, config_partition->size,
    ESP_PARTITION_MMAP_DATA, &cntxt->config_ptr, &h));
}

// --- expander flashing (program mode, USB-serial command) -------------------
// web4 sends a 2-byte command over USB-serial (WebSerial): 'F' then '0'|'1'|'2'|'A'.
// ESP flashes its embedded image via SWIO. Explicit-only; in operation there is
// no USB host, so no command ever arrives.
static void flash_one(int idx) {
  size_t len = expander_bin_length;
  int gpio = link_gpio_num(idx);
  ESP_LOGW(TAG, "FLASH expander %d (gpio%d), %u bytes", idx, gpio, (unsigned)len);

  ESP_LOGW(TAG, "Switching to 3.3V programming mode");

  // Switch to 3.3V programming mode
  gpio_set_level(VCC_SWITCH_GPIO, 1);
  vTaskDelay(pdMS_TO_TICKS(300));

  ESP_LOGW(TAG, "Flashing expander");

  link_flash_begin(idx);        // take the link, hand the raw pin to SWIO
  esp_err_t r = swio_flash_image(gpio, expander_bin, len);
  link_flash_end(idx);          // restore UART-TX idle-high, release the link

  ESP_LOGW(TAG, "Switching back to 5V normal operation");

  // Wait before switching back to 5V normal operation
  vTaskDelay(pdMS_TO_TICKS(300));
  gpio_set_level(VCC_SWITCH_GPIO, 0);

  ESP_LOGW(TAG, "FLASH expander %d -> %s", idx, esp_err_to_name(r));
}

static void flash_cmd_task(void *arg) {
  usb_serial_jtag_driver_config_t cfg = USB_SERIAL_JTAG_DRIVER_CONFIG_DEFAULT();
  if (usb_serial_jtag_driver_install(&cfg) != ESP_OK) {
    ESP_LOGE(TAG, "usb_serial_jtag install failed; flash command disabled");
    vTaskDelete(NULL);
    return;
  }
  uint8_t c;
  for (;;) {
    if (usb_serial_jtag_read_bytes(&c, 1, portMAX_DELAY) != 1) continue;
    if (c != 'F') continue;
    if (usb_serial_jtag_read_bytes(&c, 1, pdMS_TO_TICKS(1000)) != 1) continue;
    switch (c) {
      case '0': flash_one(0); break;
      case '1': flash_one(1); break;
      case '2': flash_one(2); break;
      case 'A': flash_one(0); flash_one(1); flash_one(2); break;
      // Physical bring-up probe: drive gpio0/1/2 directly (bypass the SWIO
      // bit-bang) so we can confirm the pad + read path are alive before
      // debugging protocol. From web4 send 'S0' / 'S1' / 'S2'.
      // Phase C logs the pin level 10x over 5s — short the gpio to GND by hand
      // in that window; the log MUST flip to 0. If it stays 1, the ESP read
      // path / pad / wiring is the problem, not the SWIO code.
      case 's': case 'S': {
        if (usb_serial_jtag_read_bytes(&c, 1, pdMS_TO_TICKS(1000)) != 1) break;
        int idx = c - '0';
        if (idx >= 0 && idx <= 2) {
          int g = link_gpio_num(idx);
          link_flash_begin(idx);
          swio_pin_selftest(g);
          link_flash_end(idx);
        }
        break;
      }
      // "Listen" probe for the reflash-running-chip problem (plan risk #3):
      // hammers connect() for 15s so you can power-cycle the CH32 mid-probe.
      // If it answers right after the CH32's reset (before it reaches __WFI),
      // the debug tap is alive at boot but gated during WFI sleep.
      case 'l': case 'L': {
        if (usb_serial_jtag_read_bytes(&c, 1, pdMS_TO_TICKS(1000)) != 1) break;
        int idx = c - '0';
        if (idx >= 0 && idx <= 2) {
          link_flash_begin(idx);
          swio_listen(link_gpio_num(idx), 15);
          link_flash_end(idx);
        }
        break;
      }
      default: break;
    }
  }
}

void app_main(void) {
  esp_err_t ret = nvs_flash_init();
  if (ret == ESP_ERR_NVS_NO_FREE_PAGES || ret == ESP_ERR_NVS_NEW_VERSION_FOUND) {
    ESP_ERROR_CHECK(nvs_flash_erase());
    ret = nvs_flash_init();
  }
  ESP_ERROR_CHECK(ret);

  ESP_LOGI(TAG, "HELLO XAPOH v4");

  cntxt0 = (app_context_t){ .pixels = {0, 0, 5, 100, 0, 0} };
  config_map_init(&cntxt0);

  // Initialize VCC switch GPIO (0 = 5V normal operation)
  gpio_reset_pin(VCC_SWITCH_GPIO);
  gpio_set_direction(VCC_SWITCH_GPIO, GPIO_MODE_OUTPUT);
  gpio_set_level(VCC_SWITCH_GPIO, 0);

  link_init(); // HW UART1 + 3 links parked idle-high

  // RGB strip
  rmt_tx_channel_config_t tx_chan_config = {
    .clk_src = RMT_CLK_SRC_DEFAULT,
    .gpio_num = RMT_LED_STRIP_GPIO_NUM,
    .mem_block_symbols = 64,
    .resolution_hz = RMT_LED_STRIP_RESOLUTION_HZ,
    .trans_queue_depth = 4,
  };
  ESP_ERROR_CHECK(rmt_new_tx_channel(&tx_chan_config, &led_chan));
  led_strip_encoder_config_t encoder_config = { .resolution = RMT_LED_STRIP_RESOLUTION_HZ };
  ESP_ERROR_CHECK(rmt_new_led_strip_encoder(&encoder_config, &led_encoder0));
  ESP_ERROR_CHECK(rmt_enable(led_chan));
  ESP_ERROR_CHECK(rmt_transmit(led_chan, led_encoder0, cntxt0.pixels, sizeof(cntxt0.pixels), &tx_config));
  ESP_ERROR_CHECK(rmt_tx_wait_all_done(led_chan, portMAX_DELAY));

  // Program-mode flash command listener (no-op without a USB host).
  xTaskCreate(flash_cmd_task, "flash_cmd", 4096, NULL, 5, NULL);

  wifi_init_sta(&cntxt0);
  start_webserver();

  while (1) {
    vTaskDelay(10 / portTICK_PERIOD_MS);
  }
}
